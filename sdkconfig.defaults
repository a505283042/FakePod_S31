## sdkconfig.defaults
```kconfig
# ============================================================
# FakePod S31
# ESP32-S31（双核 RISC-V）+ 16MB Flash + 片内 16MB Octal PSRAM
# ============================================================

# CPU 320MHz（S31 默认最高主频）
CONFIG_ESP_DEFAULT_CPU_FREQ_MHZ_320=y
CONFIG_ESP_DEFAULT_CPU_FREQ_MHZ=320

# ------------------------------------------------------------
# 编译优化
# ------------------------------------------------------------
CONFIG_COMPILER_OPTIMIZATION_PERF=y
CONFIG_COMPILER_OPTIMIZATION_ASSERTIONS_ENABLE=y

# ------------------------------------------------------------
# External SPI Flash：DIO / 80MHz / 16MB
# ------------------------------------------------------------
CONFIG_ESPTOOLPY_FLASHMODE_DIO=y
CONFIG_ESPTOOLPY_FLASHFREQ_80M=y
CONFIG_ESPTOOLPY_FLASHSIZE_16MB=y

# ------------------------------------------------------------
# 片内 PSRAM：16MB Octal，200MHz
# ------------------------------------------------------------
CONFIG_SPIRAM=y
CONFIG_SPIRAM_MODE_OCT=y
CONFIG_SPIRAM_SPEED_200M=y
CONFIG_SPIRAM_BOOT_INIT=y

# malloc() 可以使用 PSRAM
CONFIG_SPIRAM_USE_MALLOC=y

# 小内存优先使用内部 RAM
# 双模蓝牙实验分支：16KB 以下全优先 Internal 会让 BTDM + SDMMC + I2S 竞争 DMA RAM。
# 改为仅 <=2KB 的普通 malloc 优先 Internal；DMA / FreeRTOS 内存仍按能力分配。
CONFIG_SPIRAM_MALLOC_ALWAYSINTERNAL=2048

# 给 DMA / cache / driver 保留内部 RAM
CONFIG_SPIRAM_MALLOC_RESERVE_INTERNAL=32768
CONFIG_FATFS_LFN_HEAP=y
CONFIG_FATFS_MAX_LFN=255
CONFIG_FATFS_API_ENCODING_UTF_8=y

# esp_extractor 只保留 AVI
CONFIG_EXTRACTOR_CUSTOM_SUPPORT=n
CONFIG_WAV_EXTRACTOR_SUPPORT=n
CONFIG_MP4_EXTRACTOR_SUPPORT=n
CONFIG_TS_EXTRACTOR_SUPPORT=n
CONFIG_OGG_EXTRACTOR_SUPPORT=n
CONFIG_AVI_EXTRACTOR_SUPPORT=y
CONFIG_AUDIO_ES_EXTRACTOR_SUPPORT=n
CONFIG_CAF_EXTRACTOR_SUPPORT=n
CONFIG_FLV_EXTRACTOR_SUPPORT=n
CONFIG_EXTRACTOR_HELPER_FILE_IO_CACHE_SIZE=4096

# ------------------------------------------------------------
# USB Device / TF Card maintenance mode
# ------------------------------------------------------------
CONFIG_TINYUSB_MSC_ENABLED=y
CONFIG_TINYUSB_MSC_BUFSIZE=8192
CONFIG_TINYUSB_CDC_ENABLED=y
CONFIG_TINYUSB_CDC_COUNT=1
CONFIG_TINYUSB_CDC_RX_BUFSIZE=512
CONFIG_TINYUSB_CDC_TX_BUFSIZE=512
CONFIG_TINYUSB_CDC_EP_BUFSIZE=512
CONFIG_TINYUSB_DESC_MANUFACTURER_STRING="FakePod"
CONFIG_TINYUSB_DESC_PRODUCT_STRING="FakePod USB Service"
CONFIG_TINYUSB_DESC_MSC_STRING="FakePod TF Card"
CONFIG_TINYUSB_DESC_CDC_STRING="FakePod Serial"


# FakePod Bluetooth：Bluedroid 双模（BLE 手机遥控 + Classic 预留 A2DP Source）
# 具体 Host/Controller/A2DP 选项见 sdkconfig.bluetooth.defaults。
CONFIG_BT_ENABLED=y
CONFIG_BT_CONTROLLER_ENABLED=y
```

## src/Kconfig.projbuild
```kconfig
menu "FakePod Wi-Fi RTP audio test"

config FAKEPOD_WIFI_RTP_TEST_ENABLE
    bool "Enable RTP L24 audio streaming to a PC"
    default n
    help
        Sends decoded music PCM to a Windows/Linux RTP receiver for
        wireless audio validation. Disabled in normal firmware builds.

# Retained as a hidden legacy symbol so existing generated sdkconfig files
# remain readable. The sender now discovers the receiver automatically.
config FAKEPOD_WIFI_RTP_TEST_TARGET_IP
    string
    default ""
    depends on FAKEPOD_WIFI_RTP_TEST_ENABLE

config FAKEPOD_WIFI_RTP_TEST_DISCOVERY_PORT
    int "RTP receiver discovery UDP port"
    range 1024 65535
    default 5005
    depends on FAKEPOD_WIFI_RTP_TEST_ENABLE
    help
        UDP port used by the FakePod receiver discovery request/response.

config FAKEPOD_WIFI_RTP_TEST_PORT
    int "RTP receiver UDP port"
    range 1024 65535
    default 5004
    depends on FAKEPOD_WIFI_RTP_TEST_ENABLE
    help
        UDP port used for RTP L24 audio packets.

endmenu
```
